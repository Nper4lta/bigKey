/ {
    chosen {
        zmk,kscan = &kscan0;
    };
    kscan0: kscan_0 {
        compatible = "zmk,kscan-gpio-direct";
           label = "default_kscan";
        
        input-gpios =
            <&nice_nano D9 (GPIO_ACTIVE_LOW | GPIO_PULL_UP>;
        };
};
